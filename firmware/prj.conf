## prj.conf
```kconfig
CONFIG_NCS_SAMPLES_DEFAULTS=y

# Deferred logging helps improve LPN power consumption
# when friendship is established.
CONFIG_LOG_MODE_DEFERRED=y

# General configuration
CONFIG_NCS_APPLICATION_BOOT_BANNER_STRING="MeshyQ"
CONFIG_SYSTEM_WORKQUEUE_STACK_SIZE=2048
CONFIG_FLASH=y
CONFIG_FLASH_MAP=y
CONFIG_NVS=y
CONFIG_SETTINGS=y
CONFIG_NVS_LOOKUP_CACHE=y
CONFIG_SETTINGS_NVS_NAME_CACHE=y
CONFIG_HWINFO=y
CONFIG_GPIO=y
CONFIG_SPI=y

# The board default USB identity ("Zephyr Project" / "CDC ACM serial
# backend") is a compile-time-fixed string, so it can't include a per-chip
# hardware UID. Disable it in favor of src/usb_id.c, which builds an
# equivalent USB device but names it "MeshyQ <hex UID>" so each node in the
# fleet is distinguishable on the host.
CONFIG_CDC_ACM_SERIAL_INITIALIZE_AT_BOOT=n

# Structured JSON control protocol for the web app (src/web_api.c), on its
# own second CDC-ACM interface (web_api_cdc_acm_uart, boards/*.overlay).
CONFIG_JSON_LIBRARY=y

# SD card (Music Maker FeatherWing) storage
CONFIG_DISK_ACCESS=y
CONFIG_FILE_SYSTEM=y
CONFIG_FAT_FILESYSTEM_ELM=y

# The audio player thread reads files from the SD card while other
# threads (shell commands, mesh message handlers) can concurrently stat
# or list files on the same volume. Without this, FatFs volume access
# isn't mutex-protected across threads.
CONFIG_FS_FATFS_REENTRANT=y

# Bluetooth configuration
CONFIG_BT=y
CONFIG_BT_DEVICE_NAME="MeshyQ"
CONFIG_BT_L2CAP_TX_BUF_COUNT=16
CONFIG_BT_OBSERVER=y
CONFIG_BT_PERIPHERAL=y
CONFIG_BT_SETTINGS=y

# Disable unused Bluetooth features
CONFIG_BT_CTLR_LE_ENC=n
CONFIG_BT_PHY_UPDATE=n
CONFIG_BT_CTLR_CHAN_SEL_2=n
CONFIG_BT_CTLR_MIN_USED_CHAN=n
CONFIG_BT_CTLR_PRIVACY=n

# Bluetooth Mesh configuration
CONFIG_BT_MESH=y
# Every node relays. At the ~13-node scale of this deployment that's the
# right call, not a problem to thin out: the common advice to limit relays
# to a small percentage of nodes is aimed at large (100s of nodes) dense
# lighting-style deployments where redundant relaying causes collision
# storms. A fleet this size needs full relay coverage for connectivity.
CONFIG_BT_MESH_RELAY=y
CONFIG_BT_MESH_FRIEND=y
CONFIG_BT_MESH_STATISTIC=y

# Reliability tuning for a sparse-traffic, ~13-node fleet: with infrequent
# messages there's no "the next one will probably get through" luck, so
# each send needs its own redundancy.
#   - Relays forward each packet exactly once by default (retransmit count
#     0). That's the single biggest reliability gap for multi-hop delivery:
#     losing one over-the-air transmission at any hop loses the message
#     outright. Retransmitting twice per hop closes that gap.
#   - The originating node repeats its own first transmission one extra
#     time beyond the default, for the same reason on the first hop.
#   - The replay-protection list (CRPL) defaults to 10 entries, which is
#     under the node count; it should exceed the number of nodes with some
#     margin (entries are cheap, ~64 B each).
CONFIG_BT_MESH_RELAY_RETRANSMIT_COUNT=2
CONFIG_BT_MESH_NETWORK_TRANSMIT_COUNT=3
CONFIG_BT_MESH_CRPL=16

# Mesh buffer and segment configuration (fixes "Unable to allocate loopback")
CONFIG_BT_MESH_LOOPBACK_BUFS=8
CONFIG_BT_MESH_RX_SEG_MAX=16
CONFIG_BT_MESH_TX_SEG_MAX=16
CONFIG_BT_MESH_TX_SEG_MSG_COUNT=4

# The default of 1 only lets a node reassemble one incoming segmented
# message at a time. Every message this app sends is segmented (its max
# length is far above the ~11-byte unsegmented limit), and "cue list"
# makes every node in the ~13-node fleet reply with its own segmented
# message, unicast straight back to whichever node asked -- so that node
# needs to reassemble a whole fleet's worth of concurrent segmented
# replies at once, not just one. 16 matches the same fleet-size-plus-
# margin headroom already used above for RX_SEG_MAX/TX_SEG_MAX/CRPL.
# Each slot's exact RAM cost isn't a published constant; if a build ever
# reports insufficient RAM, this is the first value to turn back down.
CONFIG_BT_MESH_RX_SEG_MSG_COUNT=16

# Extra relay/advertising buffer headroom for the retransmit counts above:
# more retransmitted copies are in flight per message now, and this project
# has already hit one real "Unable to allocate" bug (see LOOPBACK_BUFS)
# from underestimating buffer needs.
CONFIG_BT_MESH_RELAY_BUF_COUNT=16
CONFIG_BT_MESH_ADV_BUF_COUNT=10

CONFIG_BT_MESH_PB_GATT=y
CONFIG_BT_MESH_GATT_PROXY=y
CONFIG_BT_MESH_CFG_CLI=y

# Enable Bluetooth Mesh models debug logs
CONFIG_BT_MESH_LOG_LEVEL_DBG=y

# Enable Shell module and use UART as a backend
CONFIG_SHELL=y
CONFIG_SHELL_BACKEND_SERIAL=y
CONFIG_FLASH_SHELL=n

# sys_reboot(), used by the "bootloader" shell command (src/bootloader.c)
CONFIG_REBOOT=y

CONFIG_LOG_BACKEND_RTT=n

# Defensive sizing learned the hard way during hardware bring-up: the
# default main stack (1024B) and heap (0B) are too small once SD/FAT and
# Bluetooth Mesh are both in play, and previously caused a hard-to-diagnose
# crash severe enough to prevent USB enumeration. Audio/SD/VS1053 bring-up
# now runs on its own thread (see audio_player.c) with its own 4096B stack,
# but this still gives bt_ready()'s own Bluetooth/mesh init path headroom.
CONFIG_MAIN_STACK_SIZE=4096
CONFIG_HEAP_MEM_POOL_SIZE=4096

# So a stack overflow shows up as a clear fault message instead of a
# silent crash/reset.
CONFIG_HW_STACK_PROTECTION=y
```

## include/audio_player_diag.h
```c
#ifndef AUDIO_PLAYER_DIAG_H_
#define AUDIO_PLAYER_DIAG_H_

#include <stdbool.h>

bool audio_player_is_ready(void);

#endif
```

## include/model_handler.h
```c
/*
 * Copyright (c) 2020 Nordic Semiconductor ASA
 *
 * SPDX-License-Identifier: LicenseRef-Nordic-5-Clause
 */

/**
 * @file
 * @brief Model handler
 */

#ifndef MODEL_HANDLER_H__
#define MODEL_HANDLER_H__

#include <zephyr/bluetooth/mesh.h>

#include "chat_cli.h"

#ifdef __cplusplus
extern "C" {
#endif

const struct bt_mesh_comp *model_handler_init(void);
void model_handler_set_pub(uint16_t addr, uint16_t app_key_idx, uint8_t ttl);

/** @brief Get the chat model's element address, or 0 if not yet
 * provisioned. Valid after model_handler_init() + bt_mesh_init() +
 * settings_load().
 */
uint16_t model_handler_addr(void);

/** @brief Get this node's provisioning state, address, and current presence. */
void model_handler_status(bool *provisioned, uint16_t *addr,
			  enum bt_mesh_chat_cli_presence *presence);

/** @brief Look up a presence enum value's canonical string, e.g. "available". */
const char *model_handler_presence_to_string(enum bt_mesh_chat_cli_presence presence);

/**
 * @brief Parse a presence string, e.g. "available", into its enum value.
 *
 * @retval true  @p str matched a known presence value; *presence is set.
 * @retval false @p str did not match any known presence value.
 */
bool model_handler_presence_from_string(const char *str,
					enum bt_mesh_chat_cli_presence *presence);

/** @brief Broadcast a chat text message. See bt_mesh_chat_cli_message_send(). */
int model_handler_chat_send(const char *msg);

/** @brief Send a private chat text message. See bt_mesh_chat_cli_private_message_send(). */
int model_handler_chat_send_private(uint16_t addr, const char *msg);

/** @brief Set and publish this node's presence. See bt_mesh_chat_cli_presence_set(). */
int model_handler_presence_set(enum bt_mesh_chat_cli_presence presence);

/** @brief Request another node's presence. See bt_mesh_chat_cli_presence_get(). */
int model_handler_presence_get(uint16_t addr);


/** @brief Send a diagnostic probe to a specific mesh node. */
int model_handler_diag_probe(uint16_t addr, uint32_t probe_id);

/** @brief Broadcast a request to discover arena speaker identities. */
int model_handler_diag_discover(void);

/** @brief Check audio readiness and file availability on a mesh node. */
int model_handler_diag_audio_check(uint16_t addr, const char *filename);

/** @brief Request Heartbeat statistics from a mesh node. */
int model_handler_diag_hb_get(uint16_t addr);

/** @brief Configure local Heartbeat publication. */
int model_handler_diag_hb_publish(uint8_t period_log);

/** @brief Configure local Heartbeat subscription. */
int model_handler_diag_hb_subscribe(uint16_t source_addr);


/** @brief Broadcast "play <filename>" to the mesh (see the cue/chat msg grammar). */
int model_handler_cue_play(const char *filename);

/** @brief Broadcast "find <filename>" to the mesh. */
int model_handler_cue_find(const char *filename);

/** @brief Broadcast "list" to the mesh. */
int model_handler_cue_list(void);


/** @brief Broadcast a volume setting to all remote mesh nodes. */
int model_handler_cue_volume_set(uint8_t percent);

/** @brief Request current volume levels from remote mesh nodes. */
int model_handler_cue_volume_get(void);


#ifdef __cplusplus
}
#endif

#endif /* MODEL_HANDLER_H__ */
```

## src/audio_player.c
```c
#include "audio_player.h"

#include <errno.h>
#include <stdbool.h>
#include <stdlib.h>
#include <string.h>

#include <zephyr/fs/fs.h>
#include <zephyr/kernel.h>
#include <zephyr/logging/log.h>
#include <zephyr/shell/shell.h>

#include "sd_card.h"
#include "vs1053.h"
#include <math.h>

LOG_MODULE_REGISTER(audio_player, CONFIG_LOG_DEFAULT_LEVEL);

#define AUDIO_PLAYER_PATH_MAX 128
#define AUDIO_PLAYER_READ_CHUNK 512

/* Matches vs1053.c's own startup default (VS1053_DEFAULT_VOL_ATTEN =
 * 0x20), just expressed on the 0-100 scale used by the shell command
 * below, so the reported "current" volume is right from boot even
 * before the volume command is ever used.
 */

#define VOLUME_DEFAULT_PERCENT 25
/* Generous stack: this thread also does the SD card mount and FAT
 * filesystem bring-up, which use more stack than typical playback code
 * (FatFs keeps per-call work buffers on the stack). Sizing this thread's
 * stack independently of the main thread keeps a slow or failing SD card
 * from ever touching main()'s stack or blocking bt_ready()/the shell.
 */
#define AUDIO_THREAD_STACK_SIZE 4096
#define AUDIO_THREAD_PRIO 7

K_THREAD_STACK_DEFINE(audio_thread_stack, AUDIO_THREAD_STACK_SIZE);

static struct {
	struct k_sem play_request;
	struct k_mutex lock;
	struct k_thread thread;
	k_tid_t thread_id;
	bool ready;
	bool busy;
	char pending_path[AUDIO_PLAYER_PATH_MAX];
    int64_t queued_at_ms;
} player;

static uint8_t volume_percent = VOLUME_DEFAULT_PERCENT;

/* VS1053's SCI_VOL register is an attenuation in 0.5 dB steps: 0x00 is
 * loudest, 0xFE is the quietest non-powerdown value (0xFF cuts the
 * channel's analog output entirely, so it's deliberately never reached
 * here). Map the shell's 0-100 "volume" onto that range.
 

 static uint8_t percent_to_attenuation(uint8_t percent)
{
	return (uint8_t)((100 - percent) * 254 / 100);
}



static uint8_t percent_to_attenuation(uint8_t percent)
{
    if (percent == 0) {
        return 255;  // Mute
    }

    // 0-40 dB attenuation in 0.5 dB steps
    return (uint8_t)((100 - percent) * 80 / 100);
}
*/

/* New code to linearize the dB output*/

static uint8_t percent_to_attenuation(uint8_t percent)
{
    if (percent == 0) {
        return 255;  // Mute
    }

    if (percent > 100) {
        percent = 100;
    }

    float attenuation = -40.0f * log10f(percent / 100.0f);

    return (uint8_t)lroundf(attenuation);
}

static void play_file(const char *path)
{
	static uint8_t chunk[AUDIO_PLAYER_READ_CHUNK];
	struct fs_file_t file;
	int err;
    int64_t start_ms = k_uptime_get();
    bool first_chunk = true;

	fs_file_t_init(&file);

	err = fs_open(&file, path, FS_O_READ);
	if (err) {
		LOG_WRN("Failed to open %s: %d", path, err);
		return;
	}

    LOG_INF("DIAG AUDIO_OPEN_MS=%lld", (long long)(k_uptime_get() - start_ms));

	while (1) {
		ssize_t read = fs_read(&file, chunk, sizeof(chunk));

		if (read < 0) {
			LOG_WRN("Read error on %s: %d", path, (int)read);
			break;
		}

		if (read == 0) {
			break;
		}

        if (first_chunk) {
            LOG_INF("DIAG AUDIO_FIRST_CHUNK_MS=%lld",
                    (long long)(k_uptime_get() - start_ms));
            first_chunk = false;
        }
		err = vs1053_play_data(chunk, (size_t)read);
		if (err) {
			LOG_WRN("Playback error on %s: %d", path, err);
			break;
		}
	}

	vs1053_stop();
	fs_close(&file);
}

static void audio_thread(void *arg1, void *arg2, void *arg3)
{
	ARG_UNUSED(arg1);
	ARG_UNUSED(arg2);
	ARG_UNUSED(arg3);

	/* SD mount and VS1053 bring-up happen here, on this thread's own
	 * stack, instead of inline in audio_player_init(). That keeps a
	 * slow or misbehaving SD card / codec from blocking bt_ready() (and
	 * therefore Bluetooth/mesh bring-up) or starving the shell thread.
	 */
	if (sd_card_init() || vs1053_init()) {
		LOG_ERR("Audio hardware bring-up failed; playback disabled");
		return;
	}

	/* Make sure the tracked volume_percent and the chip's actual
	 * register agree from boot, rather than relying on two separately
	 * maintained defaults staying in sync.
	 */
	vs1053_set_volume(percent_to_attenuation(volume_percent),
			   percent_to_attenuation(volume_percent));

	k_mutex_lock(&player.lock, K_FOREVER);
	player.ready = true;
	k_mutex_unlock(&player.lock);

	while (1) {
		char path[AUDIO_PLAYER_PATH_MAX];

		k_sem_take(&player.play_request, K_FOREVER);

		k_mutex_lock(&player.lock, K_FOREVER);
		strcpy(path, player.pending_path);
        int64_t queued_at_ms = player.queued_at_ms;
		k_mutex_unlock(&player.lock);

        LOG_INF("DIAG AUDIO_QUEUE_WAIT_MS=%lld",
                (long long)(k_uptime_get() - queued_at_ms));
		play_file(path);

		k_mutex_lock(&player.lock, K_FOREVER);
		player.busy = false;
		k_mutex_unlock(&player.lock);
	}
}

int audio_player_init(void)
{
	k_sem_init(&player.play_request, 0, 1);
	k_mutex_init(&player.lock);

	player.thread_id = k_thread_create(&player.thread, audio_thread_stack,
					   K_THREAD_STACK_SIZEOF(audio_thread_stack),
					   audio_thread, NULL, NULL, NULL,
					   K_PRIO_PREEMPT(AUDIO_THREAD_PRIO), 0,
					   K_NO_WAIT);
	(void)k_thread_name_set(player.thread_id, "audio_player");

	return 0;
}

bool audio_player_is_ready(void)
{
    bool ready;

    k_mutex_lock(&player.lock, K_FOREVER);
    ready = player.ready;
    k_mutex_unlock(&player.lock);

    return ready;
}

int audio_player_play_file(const char *filename)
{
	char path[AUDIO_PLAYER_PATH_MAX];
    int64_t resolve_start_ms = k_uptime_get();

	k_mutex_lock(&player.lock, K_FOREVER);
	if (!player.ready) {
		k_mutex_unlock(&player.lock);
		return -ENODEV;
	}
	k_mutex_unlock(&player.lock);

	if (!sd_card_resolve_root_file(filename, path, sizeof(path))) {
        LOG_INF("DIAG AUDIO_RESOLVE_FAIL_MS=%lld file=%s",
                (long long)(k_uptime_get() - resolve_start_ms), filename);
		return -ENOENT;
	}
    LOG_INF("DIAG AUDIO_RESOLVE_MS=%lld file=%s",
            (long long)(k_uptime_get() - resolve_start_ms), filename);

	k_mutex_lock(&player.lock, K_FOREVER);
	if (player.busy) {
		k_mutex_unlock(&player.lock);
		return -EALREADY;
	}

	player.busy = true;
	strcpy(player.pending_path, path);
    player.queued_at_ms = k_uptime_get();
	k_mutex_unlock(&player.lock);

	k_sem_give(&player.play_request);
	return 0;
}

/* Local-only trigger: plays straight from the shell, independent of mesh
 * state, so a single DUT with nothing else on the network can still be
 * tested.
 */
static int cmd_play(const struct shell *shell, size_t argc, char *argv[])
{
	int err;

	err = audio_player_play_file(argv[1]);
	switch (err) {
	case 0:
		shell_print(shell, "Playing %s", argv[1]);
		break;
	case -ENOENT:
		shell_error(shell, "No such file in the SD card's root directory: %s", argv[1]);
		break;
	case -EALREADY:
		shell_error(shell, "Already playing a file");
		break;
	case -ENODEV:
		shell_error(shell, "Audio player not initialized");
		break;
	default:
		shell_error(shell, "Failed to play %s: %d", argv[1], err);
		break;
	}

	return 0;
}

SHELL_CMD_ARG_REGISTER(play, NULL,
			"Play a file from the SD card's root directory <filename>", cmd_play, 2,
			0);

uint8_t audio_player_get_volume(void)
{
	return volume_percent;
}

int audio_player_set_volume(uint8_t percent)
{
	bool ready;

	if (percent > 100) {
		return -EINVAL;
	}

	k_mutex_lock(&player.lock, K_FOREVER);
	ready = player.ready;
	k_mutex_unlock(&player.lock);

	if (!ready) {
		return -ENODEV;
	}

	volume_percent = percent;
	vs1053_set_volume(percent_to_attenuation(volume_percent),
			   percent_to_attenuation(volume_percent));

	return 0;
}

/* Volume is a VS1053 hardware register, not a per-file setting: it stays
 * wherever it's set across every subsequent play (and every mesh-triggered
 * playback), so it's its own command rather than a `play` argument.
 */
static int cmd_volume(const struct shell *shell, size_t argc, char *argv[])
{
	long percent;
	char *endptr;
	int err;

	if (argc == 1) {
		shell_print(shell, "Volume: %u%%", audio_player_get_volume());
		return 0;
	}

	percent = strtol(argv[1], &endptr, 10);
	if (*endptr != '\0' || percent < 0 || percent > 100) {
		shell_error(shell, "Volume must be 0-100");
		return -EINVAL;
	}

	err = audio_player_set_volume((uint8_t)percent);
	switch (err) {
	case 0:
		shell_print(shell, "Volume set to %u%%", audio_player_get_volume());
		break;
	case -ENODEV:
		shell_error(shell, "Audio player not initialized");
		break;
	default:
		shell_error(shell, "Failed to set volume: %d", err);
		break;
	}

	return 0;
}

SHELL_CMD_ARG_REGISTER(volume, NULL, "Get or set output volume, persists across play [0-100]",
			cmd_volume, 1, 1);
```

## src/web_api.c
```c
/** @file
 *  @brief Structured JSON control protocol for the MeshyQ web app.
 *
 *  Runs entirely on web_api_cdc_acm_uart (see boards, *.overlay), a second
 *  USB CDC-ACM interface separate from the interactive shell/console. The
 *  shell's console shares its byte stream with Zephyr's own logging
 *  (CONFIG_SHELL_LOG_BACKEND) and async shell_print() calls from
 *  model_handler.c, which makes it unsuitable for a client that needs to
 *  reliably parse command responses. This module exists so the web app
 *  never has to scrape that stream: one line in, one line out, always
 *  valid JSON.
 *
 *  Wire protocol: newline-delimited JSON.
 *    Host -> device: {"v":1,"id":<n>,"cmd":"<name>","args":{...}}
 *    Device -> host (response): {"v":1,"id":<n>,"ok":true,"result":{...}}
 *                             or {"v":1,"id":<n>,"ok":false,"error":{"code":"...","message":"..."}}
 *    Device -> host (event, unsolicited): {"v":1,"event":"<name>",...}
 *  "v" is this wire protocol's version, independent of APP_VERSION_STRING;
 *  bump WEB_API_PROTOCOL_VERSION only on breaking shape changes.
 */

#include "web_api.h"

#include <errno.h>
#include <stdarg.h>
#include <stdio.h>
#include <string.h>

#include <app_version.h>
#include <zephyr/data/json.h>
#include <zephyr/device.h>
#include <zephyr/drivers/uart.h>
#include <zephyr/kernel.h>
#include <zephyr/sys/ring_buffer.h>
#include <zephyr/usb/usbd.h>

#include <zephyr/logging/log.h>
LOG_MODULE_REGISTER(web_api, CONFIG_LOG_DEFAULT_LEVEL);

#include "audio_player.h"
#include "model_handler.h"
#include "sd_card.h"

#define WEB_API_PROTOCOL_VERSION 1

static const struct device *const web_api_uart =
	DEVICE_DT_GET(DT_NODELABEL(web_api_cdc_acm_uart));

/******************************************************************************/
/******************************** RX pipeline ********************************/
/******************************************************************************/
#define WEB_API_RX_RINGBUF_SIZE 256
#define WEB_API_THREAD_STACK_SIZE 2560
/* One priority step below model_handler.c's LIST_WORKER_THREAD_PRIO (8), so
 * JSON command handling can never delay a pending mesh "list" scan.
 */
#define WEB_API_THREAD_PRIO 9

RING_BUF_DECLARE(web_api_rx_ringbuf, WEB_API_RX_RINGBUF_SIZE);
K_SEM_DEFINE(web_api_rx_sem, 0, 1);
K_SEM_DEFINE(web_api_dtr_sem, 0, 1);

K_THREAD_STACK_DEFINE(web_api_thread_stack, WEB_API_THREAD_STACK_SIZE);

static struct {
	struct k_thread thread;
	k_tid_t thread_id;
	bool connected;
	char line[CONFIG_WEB_API_LINE_BUF_SIZE];
	size_t line_len;
} web_api;

static void web_api_handle_line(char *line, size_t len);

static void web_api_uart_isr(const struct device *dev, void *user_data)
{
	ARG_UNUSED(user_data);

	while (uart_irq_update(dev) && uart_irq_is_pending(dev)) {
		if (uart_irq_rx_ready(dev)) {
			uint8_t buf[32];
			int n = uart_fifo_read(dev, buf, sizeof(buf));

			if (n > 0) {
				uint32_t put = ring_buf_put(&web_api_rx_ringbuf, buf, (uint32_t)n);

				if (put < (uint32_t)n) {
					LOG_WRN("RX ring buffer full, dropped %d byte(s)",
						n - (int)put);
				}
				k_sem_give(&web_api_rx_sem);
			}
		}
	}
}

void web_api_usbd_msg_handler(struct usbd_context *ctx, const struct usbd_msg *msg)
{
	ARG_UNUSED(ctx);

	if (msg->type != USBD_MSG_CDC_ACM_CONTROL_LINE_STATE || msg->dev != web_api_uart) {
		return;
	}

	uint32_t dtr = 0;

	uart_line_ctrl_get(msg->dev, UART_LINE_CTRL_DTR, &dtr);
	if (dtr) {
		k_sem_give(&web_api_dtr_sem);
	} else {
		web_api.connected = false;
		/* Wake the thread if it's blocked waiting for RX, so it
		 * notices "connected" went false and loops back to wait for
		 * DTR again instead of blocking forever.
		 */
		k_sem_give(&web_api_rx_sem);
	}
}

static void web_api_thread(void *arg1, void *arg2, void *arg3)
{
	ARG_UNUSED(arg1);
	ARG_UNUSED(arg2);
	ARG_UNUSED(arg3);

	uart_irq_callback_set(web_api_uart, web_api_uart_isr);

	while (1) {
		uint8_t byte;

		/* Only start pulling bytes off the wire once a client has
		 * actually opened the port; re-armed every time DTR drops
		 * and comes back.
		 */
		k_sem_take(&web_api_dtr_sem, K_FOREVER);
		web_api.connected = true;
		web_api.line_len = 0;
		uart_irq_rx_enable(web_api_uart);

		while (web_api.connected) {
			k_sem_take(&web_api_rx_sem, K_FOREVER);

			while (ring_buf_get(&web_api_rx_ringbuf, &byte, 1) == 1) {
				if (byte == '\n') {
					web_api.line[web_api.line_len] = '\0';
					web_api_handle_line(web_api.line, web_api.line_len);
					web_api.line_len = 0;
				} else if (byte != '\r') {
					if (web_api.line_len <
					    sizeof(web_api.line) - 1) {
						web_api.line[web_api.line_len++] = byte;
					} else {
						/* Line too long for the buffer:
						 * drop it rather than overrun or
						 * silently truncate a command.
						 */
						LOG_WRN("Request line too long, dropping it");
						web_api.line_len = 0;
					}
				}
			}
		}

		uart_irq_rx_disable(web_api_uart);
	}
}

/******************************************************************************/
/****************************** TX / responses ********************************/
/******************************************************************************/
static void web_api_send_line(const char *json, size_t len)
{
	size_t i;

	if (!web_api.connected) {
		return;
	}

	for (i = 0; i < len; i++) {
		uart_poll_out(web_api_uart, (unsigned char)json[i]);
	}
	uart_poll_out(web_api_uart, '\n');
}

/* Escapes `text` into `buf` for embedding as a JSON string body (without the
 * surrounding quotes). `text` may be arbitrary (mesh chat text, filenames);
 * falls back to an empty string if the escaped form doesn't fit, rather than
 * emit broken JSON.
 */
static const char *web_api_escape(char *buf, size_t buf_size, const char *text)
{
	size_t len = strlen(text);

	if (len >= buf_size) {
		len = buf_size - 1;
	}
	memcpy(buf, text, len);
	buf[len] = '\0';

	if (json_escape(buf, &len, buf_size) < 0) {
		buf[0] = '\0';
	}

	return buf;
}

/* Appends a formatted string to buf at *pos, clamping *pos to buf_size on
 * overflow so a later call can't underflow "buf_size - *pos" and write past
 * the end of buf.
 */
static void web_api_append(char *buf, size_t buf_size, size_t *pos, const char *fmt, ...)
{
	va_list args;
	int n;

	if (*pos >= buf_size) {
		return;
	}

	va_start(args, fmt);
	n = vsnprintf(&buf[*pos], buf_size - *pos, fmt, args);
	va_end(args);

	if (n < 0 || (size_t)n >= buf_size - *pos) {
		*pos = buf_size;
	} else {
		*pos += (size_t)n;
	}
}

static void send_result_empty(int32_t id)
{
	char buf[48];
	int len;

	len = snprintf(buf, sizeof(buf), "{\"v\":%d,\"id\":%d,\"ok\":true,\"result\":{}}",
		       WEB_API_PROTOCOL_VERSION, id);
	if (len > 0 && (size_t)len < sizeof(buf)) {
		web_api_send_line(buf, (size_t)len);
	}
}

/* `code`/`message` must always be our own fixed string literals (never
 * mesh/user-originated text) -- they're embedded without escaping.
 */
static void send_error(int32_t id, const char *code, const char *message)
{
	char buf[192];
	int len;

	len = snprintf(buf, sizeof(buf),
		       "{\"v\":%d,\"id\":%d,\"ok\":false,\"error\":{\"code\":\"%s\",\"message\":\"%s\"}}",
		       WEB_API_PROTOCOL_VERSION, id, code, message);
	if (len > 0 && (size_t)len < sizeof(buf)) {
		web_api_send_line(buf, (size_t)len);
	}
}

static void send_result_status(int32_t id, bool provisioned, uint16_t addr,
			       const char *presence)
{
	char buf[128];
	int len;

	len = snprintf(buf, sizeof(buf),
		       "{\"v\":%d,\"id\":%d,\"ok\":true,\"result\":"
		       "{\"provisioned\":%s,\"addr\":\"0x%04x\",\"presence\":\"%s\","
		       "\"firmware_version\":\"%s\"}}",
		       WEB_API_PROTOCOL_VERSION, id, provisioned ? "true" : "false", addr,
		       presence, APP_VERSION_STRING);
	if (len > 0 && (size_t)len < sizeof(buf)) {
		web_api_send_line(buf, (size_t)len);
	}
}

static void send_result_volume(int32_t id, uint8_t percent)
{
	char buf[64];
	int len;

	len = snprintf(buf, sizeof(buf), "{\"v\":%d,\"id\":%d,\"ok\":true,\"result\":{\"percent\":%u}}",
		       WEB_API_PROTOCOL_VERSION, id, percent);
	if (len > 0 && (size_t)len < sizeof(buf)) {
		web_api_send_line(buf, (size_t)len);
	}
}

#define WEB_API_LS_MAX_ENTRIES 48
#define WEB_API_LS_NAME_MAX 64

struct ls_ctx {
	char names[WEB_API_LS_MAX_ENTRIES][WEB_API_LS_NAME_MAX];
	size_t count;
};

/* Directories get a trailing "/", same convention as the shell's `ls`. */
static void ls_collect_cb(const char *name, bool is_dir, uint32_t size, void *user_data)
{
	struct ls_ctx *ctx = user_data;

	ARG_UNUSED(size);

	if (ctx->count >= WEB_API_LS_MAX_ENTRIES) {
		return;
	}

	snprintf(ctx->names[ctx->count], WEB_API_LS_NAME_MAX, is_dir ? "%s/" : "%s", name);
	ctx->count++;
}

static void handle_ls(int32_t id)
{
	struct ls_ctx ctx = { .count = 0 };
	char line[CONFIG_WEB_API_LINE_BUF_SIZE];
	char escaped[WEB_API_LS_NAME_MAX * 2];
	size_t pos = 0;
	size_t i;
	int err;

	err = sd_card_list_root(ls_collect_cb, &ctx);
	if (err) {
		send_error(id, "EIO", "Failed to list the SD card's root directory");
		return;
	}

	web_api_append(line, sizeof(line), &pos,
		       "{\"v\":%d,\"id\":%d,\"ok\":true,\"result\":{\"files\":[",
		       WEB_API_PROTOCOL_VERSION, id);

	for (i = 0; i < ctx.count; i++) {
		web_api_append(line, sizeof(line), &pos, "%s\"%s\"", i ? "," : "",
			       web_api_escape(escaped, sizeof(escaped), ctx.names[i]));
	}

	if (pos >= sizeof(line)) {
		send_error(id, "E2BIG", "Directory listing too large for one message");
		return;
	}

	web_api_append(line, sizeof(line), &pos, "]}}");
	if (pos >= sizeof(line)) {
		send_error(id, "E2BIG", "Directory listing too large for one message");
		return;
	}

	web_api_send_line(line, pos);
}

/******************************************************************************/
/****************************** Async events **********************************/
/******************************************************************************/
static void send_event_chat(const char *event, uint16_t addr, const char *text)
{
	char escaped[256];
	char line[320];
	int len;

	if (!web_api.connected) {
		return;
	}

	len = snprintf(line, sizeof(line),
		       "{\"v\":%d,\"event\":\"%s\",\"addr\":\"0x%04x\",\"text\":\"%s\"}",
		       WEB_API_PROTOCOL_VERSION, event, addr,
		       web_api_escape(escaped, sizeof(escaped), text));
	if (len > 0 && (size_t)len < sizeof(line)) {
		web_api_send_line(line, (size_t)len);
	}
}

void web_api_notify_chat_message(uint16_t addr, const char *text)
{
	send_event_chat("chat_message", addr, text);
}

void web_api_notify_chat_private_message(uint16_t addr, const char *text)
{
	send_event_chat("chat_private_message", addr, text);
}

void web_api_notify_chat_message_reply(uint16_t addr, const char *text)
{
	send_event_chat("chat_message_reply", addr, text);
}

void web_api_notify_presence(uint16_t addr, enum bt_mesh_chat_cli_presence presence)
{
	char buf[96];
	int len;

	if (!web_api.connected) {
		return;
	}

	len = snprintf(buf, sizeof(buf), "{\"v\":%d,\"event\":\"presence\",\"addr\":\"0x%04x\",\"presence\":\"%s\"}",
		       WEB_API_PROTOCOL_VERSION, addr, model_handler_presence_to_string(presence));
	if (len > 0 && (size_t)len < sizeof(buf)) {
		web_api_send_line(buf, (size_t)len);
	}
}

/******************************************************************************/
/***************************** Request dispatch ********************************/
/******************************************************************************/
struct web_api_args {
	const char *filename;
	const char *text;
	const char *presence;
	int32_t addr;
	int32_t percent;
};

struct web_api_request {
	int32_t v;
	int32_t id;
	const char *cmd;
	struct web_api_args args;
};

static const struct json_obj_descr args_descr[] = {
	JSON_OBJ_DESCR_PRIM(struct web_api_args, filename, JSON_TOK_STRING),
	JSON_OBJ_DESCR_PRIM(struct web_api_args, text, JSON_TOK_STRING),
	JSON_OBJ_DESCR_PRIM(struct web_api_args, presence, JSON_TOK_STRING),
	JSON_OBJ_DESCR_PRIM(struct web_api_args, addr, JSON_TOK_NUMBER),
	JSON_OBJ_DESCR_PRIM(struct web_api_args, percent, JSON_TOK_NUMBER),
};

static const struct json_obj_descr request_descr[] = {
	JSON_OBJ_DESCR_PRIM(struct web_api_request, v, JSON_TOK_NUMBER),
	JSON_OBJ_DESCR_PRIM(struct web_api_request, id, JSON_TOK_NUMBER),
	JSON_OBJ_DESCR_PRIM(struct web_api_request, cmd, JSON_TOK_STRING),
	JSON_OBJ_DESCR_OBJECT(struct web_api_request, args, args_descr),
};

static void handle_play(int32_t id, const struct web_api_args *args)
{
	int err;

	if (!args->filename) {
		send_error(id, "EINVAL", "Missing \"filename\"");
		return;
	}

	err = audio_player_play_file(args->filename);
	switch (err) {
	case 0:
		send_result_empty(id);
		break;
	case -ENOENT:
		send_error(id, "ENOENT", "No such file in the SD card's root directory");
		break;
	case -EALREADY:
		send_error(id, "EALREADY", "Already playing a file");
		break;
	case -ENODEV:
		send_error(id, "ENODEV", "Audio player not initialized");
		break;
	default:
		send_error(id, "EIO", "Failed to play file");
		break;
	}
}

static void handle_volume(int32_t id, const struct web_api_args *args)
{
	int err;

	if (args->percent >= 0) {
		if (args->percent > 100) {
			send_error(id, "EINVAL", "\"percent\" must be 0-100");
			return;
		}

		err = audio_player_set_volume((uint8_t)args->percent);
		if (err == -ENODEV) {
			send_error(id, "ENODEV", "Audio player not initialized");
			return;
		} else if (err) {
			send_error(id, "EINVAL", "Failed to set volume");
			return;
		}
	}

	send_result_volume(id, audio_player_get_volume());
}

static void handle_status(int32_t id)
{
	bool provisioned;
	uint16_t addr;
	enum bt_mesh_chat_cli_presence presence;

	model_handler_status(&provisioned, &addr, &presence);
	send_result_status(id, provisioned, addr, model_handler_presence_to_string(presence));
}

static void handle_chat_send(int32_t id, const struct web_api_args *args)
{
	int err;

	if (!args->text) {
		send_error(id, "EINVAL", "Missing \"text\"");
		return;
	}

	err = model_handler_chat_send(args->text);
	if (err) {
		send_error(id, "EIO", "Failed to send message");
		return;
	}

	send_result_empty(id);
}

static void handle_chat_send_private(int32_t id, const struct web_api_args *args)
{
	int err;

	if (!args->text || args->addr <= 0) {
		send_error(id, "EINVAL", "Missing \"addr\" or \"text\"");
		return;
	}

	err = model_handler_chat_send_private((uint16_t)args->addr, args->text);
	if (err) {
		send_error(id, "EIO", "Failed to send private message");
		return;
	}

	send_result_empty(id);
}

static void handle_presence_set(int32_t id, const struct web_api_args *args)
{
	enum bt_mesh_chat_cli_presence presence;
	int err;

	if (!args->presence || !model_handler_presence_from_string(args->presence, &presence)) {
		send_error(id, "EINVAL", "Unknown or missing \"presence\"");
		return;
	}

	err = model_handler_presence_set(presence);
	if (err) {
		send_error(id, "EIO", "Failed to update presence");
		return;
	}

	send_result_empty(id);
}

static void handle_presence_get(int32_t id, const struct web_api_args *args)
{
	int err;

	if (args->addr <= 0) {
		send_error(id, "EINVAL", "Missing \"addr\"");
		return;
	}

	err = model_handler_presence_get((uint16_t)args->addr);
	if (err) {
		send_error(id, "EIO", "Failed to request presence");
		return;
	}

	/* The remote node's presence arrives later as an async "presence"
	 * event, not synchronously in this response.
	 */
	send_result_empty(id);
}


/** @brief Request speaker identification from the mesh. */
static void handle_diag_discover(int32_t id)
{
    int err = model_handler_diag_discover();

    if (err) {
        send_error(id, "EIO",
                   "Failed to request speaker discovery");
        return;
    }

    send_result_empty(id);
}

/** @brief Check audio readiness and file availability on a node. */
static void handle_diag_audio_check(
    int32_t id,
    const struct web_api_args *args)
{
    if (args->addr < 1 || args->addr > 0x7fff ||
        !args->filename) {
        send_error(id, "EINVAL",
                   "Valid node address and filename required");
        return;
    }

    int err = model_handler_diag_audio_check(
        (uint16_t)args->addr,
        args->filename);

    if (err) {
        send_error(id, "EIO",
                   "Failed to request audio check");
        return;
    }

    send_result_empty(id);
}

/**
 * @brief Start a diagnostic probe from the web API.
 *
 * The immediate JSON response confirms the request
 * was submitted. Probe results arrive asynchronously.
 */
static void handle_diag_probe(
    int32_t id,
    const struct web_api_args *args)
{
    static uint32_t next_id = 1;
    int err;

    if (args->addr < 1 || args->addr > 0x7fff) {
        send_error(
            id,
            "EINVAL",
            "Valid unicast addr required"
        );
        return;
    }

    err = model_handler_diag_probe(
        (uint16_t)args->addr,
        next_id++
    );

    if (err) {
        send_error(
            id,
            "EBUSY",
            "Could not start diagnostic probe"
        );
        return;
    }

    send_result_empty(id);
}

/**
 * @brief Request Heartbeat statistics from a remote node.
 */
static void handle_diag_hb_get(
    int32_t id,
    const struct web_api_args *args)
{
    int err;

    if (args->addr < 1 || args->addr > 0x7fff) {
        send_error(
            id,
            "EINVAL",
            "Valid unicast addr required"
        );
        return;
    }

    err = model_handler_diag_hb_get(
        (uint16_t)args->addr
    );

    if (err) {
        send_error(
            id,
            "EIO",
            "Could not request Heartbeat statistics"
        );
        return;
    }

    send_result_empty(id);
}

static void handle_cue_play(int32_t id, const struct web_api_args *args)
{
	int err;

	if (!args->filename) {
		send_error(id, "EINVAL", "Missing \"filename\"");
		return;
	}

	err = model_handler_cue_play(args->filename);
	if (err) {
		send_error(id, "EIO", "Failed to broadcast play command");
		return;
	}

	send_result_empty(id);
}

static void handle_cue_find(int32_t id, const struct web_api_args *args)
{
	int err;

	if (!args->filename) {
		send_error(id, "EINVAL", "Missing \"filename\"");
		return;
	}

	err = model_handler_cue_find(args->filename);
	if (err) {
		send_error(id, "EIO", "Failed to broadcast find command");
		return;
	}

	send_result_empty(id);
}

static void handle_cue_list(int32_t id)
{
	int err;

	err = model_handler_cue_list();
	if (err) {
		send_error(id, "EIO", "Failed to broadcast list command");
		return;
	}

	send_result_empty(id);
}

/* Request current volume from mesh nodes */
static void handle_cue_volume_get(int32_t id)
{
    int err;

    err = model_handler_cue_volume_get();
    if (err) {
        send_error(id, "EIO", "Failed to request mesh volumes");
        return;
    }

    send_result_empty(id);
}

/* Set the volume of remote mesh nodes */
static void handle_cue_volume_set(
    int32_t id,
    const struct web_api_args *args)
{
    int err;

    /* Check that a valid volume was provided */
    if (args->percent < 0 || args->percent > 100) {
        send_error(id, "EINVAL", "Volume must be between 0 and 100");
        return;
    }

    err = model_handler_cue_volume_set((uint8_t)args->percent);

    if (err) {
        send_error(id, "EIO", "Failed to broadcast volume command");
        return;
    }

    send_result_empty(id);
}


static void web_api_handle_line(char *line, size_t len)
{
	struct web_api_request req = {
		.v = 0,
		.id = 0,
		.cmd = NULL,
		.args = {
			.filename = NULL,
			.text = NULL,
			.presence = NULL,
			.addr = 0,
			.percent = -1,
		},
	};
	int64_t mask;

	if (len == 0) {
		return;
	}

	mask = json_obj_parse(line, len, request_descr, ARRAY_SIZE(request_descr), &req);
	if (mask < 0 || !req.cmd) {
		LOG_WRN("Failed to parse request (%lld): %s", mask, line);
		send_error(0, "EINVAL", "Malformed request");
		return;
	}

	if (!strcmp(req.cmd, "ping")) {
		send_result_empty(req.id);
	} else if (!strcmp(req.cmd, "status")) {
		handle_status(req.id);
	} else if (!strcmp(req.cmd, "play")) {
		handle_play(req.id, &req.args);
	} else if (!strcmp(req.cmd, "volume")) {
		handle_volume(req.id, &req.args);
	} else if (!strcmp(req.cmd, "ls")) {
		handle_ls(req.id);
	} else if (!strcmp(req.cmd, "chat_send")) {
		handle_chat_send(req.id, &req.args);
	} else if (!strcmp(req.cmd, "chat_send_private")) {
		handle_chat_send_private(req.id, &req.args);
	} else if (!strcmp(req.cmd, "presence_set")) {
		handle_presence_set(req.id, &req.args);
	} else if (!strcmp(req.cmd, "presence_get")) {
		handle_presence_get(req.id, &req.args);
	} else if (!strcmp(req.cmd, "diag_discover")) {
		handle_diag_discover(req.id);
	} else if (!strcmp(req.cmd, "diag_audio_check")) {
		handle_diag_audio_check(req.id, &req.args);
	} else if (!strcmp(req.cmd, "diag_probe")) {
		handle_diag_probe(req.id, &req.args);
	} else if (!strcmp(req.cmd, "diag_hb_get")) {
		handle_diag_hb_get(req.id, &req.args);
	} else if (!strcmp(req.cmd, "cue_play")) {
		handle_cue_play(req.id, &req.args);
	} else if (!strcmp(req.cmd, "cue_find")) {
		handle_cue_find(req.id, &req.args);
	} else if (!strcmp(req.cmd, "cue_list")) {
		handle_cue_list(req.id);
	} else if (!strcmp(req.cmd, "cue_volume_get")) {
    	handle_cue_volume_get(req.id);
	} else if (!strcmp(req.cmd, "cue_volume_set")) {
    	handle_cue_volume_set(req.id, &req.args);

	} else {
		send_error(req.id, "EINVAL", "Unknown command");
	}
}

/******************************************************************************/
/******************************** Public API **********************************/
/******************************************************************************/
int web_api_init(void)
{
	if (!device_is_ready(web_api_uart)) {
		LOG_ERR("web_api_cdc_acm_uart not ready");
		return -ENODEV;
	}

	web_api.thread_id = k_thread_create(&web_api.thread, web_api_thread_stack,
					    K_THREAD_STACK_SIZEOF(web_api_thread_stack),
					    web_api_thread, NULL, NULL, NULL,
					    K_PRIO_PREEMPT(WEB_API_THREAD_PRIO), 0,
					    K_NO_WAIT);
	(void)k_thread_name_set(web_api.thread_id, "web_api");

	return 0;
}
```
